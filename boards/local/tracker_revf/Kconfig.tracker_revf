## boards/local/tracker_revf/Kconfig.tracker_revf
```kconfig
config BOARD_TRACKER_REVF
	select SOC_NRF54L15_CPUAPP if BOARD_TRACKER_REVF_NRF54L15_CPUAPP
```

## boards/local/tracker_revf/board.yml
```yaml
board:
  name: tracker_revf
  full_name: RevF nRF54L15 tracker
  vendor: local
  socs:
    - name: nrf54l15
```
